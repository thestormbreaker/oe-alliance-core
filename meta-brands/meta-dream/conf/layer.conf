## meta-brands/meta-dream/conf/layer.conf
```bitbake
# We have a conf and classes directory, append to BBPATH
BBPATH .= ":${LAYERDIR}"

# We have a recipes directory, add to BBFILES
BBFILES += "${LAYERDIR}/recipes-*/*.bb ${LAYERDIR}/recipes-*/*.bbappend \
            ${LAYERDIR}/recipes-*/*/*.bb ${LAYERDIR}/recipes-*/*/*.bbappend \
            ${LAYERDIR}/recipes-*/*/*/*.bb ${LAYERDIR}/recipes-*/*/*/*.bbappend"

BBFILE_COLLECTIONS += "dream-layer"
BBFILE_PATTERN_dream-layer := "^${LAYERDIR}/"
BBFILE_PRIORITY_dream-layer = "7"

LAYERSERIES_COMPAT_dream-layer = "warrior zeus"

OEA-META-DREAM-BASE := '${@os.path.normpath("${LAYERDIR}/")}'

# Additional license directories.
LICENSE_PATH += "${LAYERDIR}/conf/license"
```

## meta-brands/meta-dream/conf/machine/dreamone.conf
```bitbake
MACHINE_NAME = "dreamone"

require conf/machine/include/arm/arch-armv8a.inc

MACHINE_ESSENTIAL_EXTRA_RRECOMMENDS = "bcmdhd dreambox-dvb-modules"
MACHINE_EXTRA_RRECOMMENDS = "kernel-modules"

SERIAL_CONSOLES = "1000000;ttyS0"

PREFERRED_PROVIDER_virtual/egl ?= "meson-mali"
PREFERRED_PROVIDER_virtual/libgles2 ?= "meson-mali"
PREFERRED_PROVIDER_virtual/libgl ?= "mesa-gl"
PREFERRED_PROVIDER_virtual/mesa ?= "mesa-gl"

PREFERRED_PROVIDER_virtual/kernel ?= "linux-meson64"
PREFERRED_VERSION_linux-meson64 ?= "4.9%"

UBOOT_ENTRYPOINT = "0x1080000"

KERNEL_CLASSES ?= "kernel-fitimage"
KERNEL_IMAGETYPE ?= "Image.gz"

#DISTRO_FEATURES = "systemd"
#DISTRO_FEATURES = "mesa-gl"
#DISTRO_FEATURES = "opengl"
MACHINE_FEATURES = "hdmicec cec nrf52 usbconsole serial usbgadget usbhost vfat ext2 rtc alsa screen"

SOC_FAMILY = "meson64"
require conf/machine/include/soc-family.inc

PACKAGECONFIG_pn-ffmpeg = "avdevice avfilter avcodec avformat swresample swscale postproc"

BOX_BRAND = "dreambox"

MACHINE_ESSENTIAL_EXTRA_RDEPENDS += "\
    bcmdhd \
    bcmdhd-firmware \
    dreambox-dvb-modules \
    meson-mali \
    meson-mali-module-bifrost-r12p0 \
    ffmpeg \
    kernel-modules \
    miscdone \
    libsystemdone \
    gstreamer1.0 \
    "

KERNEL_MODULE_AUTOLOAD += "\
	mali_kbase \
	dhd \
	stb-core \
	meson64 \
	fp-dev \
	ble \
	videograbber \
	dreamframeinject \
	dreambox_rc2 \
	lcd \
	libavcodec \
	libamlogic \
	encoder \
	amvdec_avs \
	amvdec_avs2 \
	amvdec_h264 \
	amvdec_h264mvc \
	amvdec_h265 \
	amvdec_mh264 \
	amvdec_mjpeg \
	amvdec_mmjpeg \
	amvdec_mmpeg4 \
	amvdec_mpeg12 \
	amvdec_mpeg4 \
	amvdec_ports \
	amvdec_real \
	amvdec_vc1 \
	amvdec_vp9 \
	nfsd \
	"
```

## meta-brands/meta-dream/conf/machine/include/dreambox.inc
```bitbake
# dreambox.inc
# We know about rtc
include conf/machine/include/build-extras.inc

BRAND_OEM = "dreambox"
MACHINE_BRAND = "Dreambox"

EXTRA_IMAGEDEPENDS += "dreambox-secondstage-${MACHINE}"

MACHINE_ESSENTIAL_EXTRA_RDEPENDS += "dreambox-dvb-modules-${MACHINE}"
MACHINE_ESSENTIAL_EXTRA_RDEPENDS += "packagegroup-opendreambox-essential"

GLIBC_EXTRA_OECONF = "--with-tls --with-__thread"

DVBMEDIASINK_CONFIG = "--with-dreambox --with-pcm --with-wma --with-wmv --with-dtsdownmix --with-eac3 --with-dts"
DVBMEDIASINK_CONFIG_dm7080 = "--with-dreambox --with-pcm --with-wma --with-wmv --with-dtsdownmix --with-eac3 --with-dts --with-vb6 --with-vb8 --with-spark"
DVBMEDIASINK_CONFIG_dm820 = "--with-dreambox --with-pcm --with-wma --with-wmv --with-dtsdownmix --with-eac3 --with-dts --with-vb6 --with-vb8 --with-spark"
DVBMEDIASINK_CONFIG_dm520 = "--with-dreambox --with-pcm --with-wma --with-wmv --with-dtsdownmix --with-eac3 --with-dts --with-vb6 --with-vb8 --with-spark --with-h265"
DVBMEDIASINK_CONFIG_dreamone = "--with-pcm --with-wma --with-wmv --with-dtsdownmix --with-eac3 --with-dts --with-vb6 --with-vb8 --with-spark --with-h265"

include conf/machine/include/autoload-filesystems.inc
require conf/machine/include/soc-family.inc
require conf/machine/box-hardware.inc

MACHINE_EXTRA_RRECOMMENDS += " \
    gstreamer1.0-plugin-dvbmediasink \
    gstreamer1.0-libav \
    kernel-module-cifs \
    kernel-module-autofs4 \
    kernel-module-hmac \
    kernel-module-md4 \
    kernel-module-ecb \
    tpmd \
    kernel-module-fuse \
    kernel-module-nfsd \
    kernel-module-exportfs \
    kernel-module-snd-oss \
    kernel-module-snd-pcm-oss \
    ${@bb.utils.contains('MACHINE_FEATURES', 'v3d', 'libvc5dream', '',d)} \
    "
    
MACHINE_FEATURES += "dreambox alsa wifi usbhost 3dtv switchoff tpm blindscan-dvbs boxmodel feature1 feature2"
# Add "dreambox" override for recipes
MACHINEOVERRIDES .= ":dreambox"

PREFERRED_PROVIDER_virtual/bootloader = "dreambox-secondstage-${MACHINE}"
PREFERRED_PROVIDER_virtual/kernel = "linux-dreambox"
PREFERRED_PROVIDER_virtual/kodi = "stb-kodi-${MACHINE}"

PREFERRED_PROVIDER_virtual/blindscan-dvbs = "dreambox-blindscan-utils"
PREFERRED_PROVIDER_virtual/blindscan-dvbc = "dreambox-blindscan-utils"

KERNEL_IMAGETYPE = "vmlinux"
KERNEL_OUTPUT = "${KERNEL_IMAGETYPE}"
KERNEL_OUTPUT_DIR = "."
KERNEL_CONSOLE = "${@bb.utils.contains('MACHINE_FEATURES', 'usbconsole', 'ttyS0,115200', 'null', d)}"

PREFERRED_VERSION_linux-dreambox ?= "3.2"

GCCVERSION = "8.%"

PREFERRED_VERSION_rt8812au = "4.3.14"

DREAMBOX_BUILDIMAGE = "buildimage --arch ${MACHINE} ${EXTRA_BUILDCMD} \
	--erase-block-size ${DREAMBOX_ERASE_BLOCK_SIZE} \
	--flash-size ${DREAMBOX_FLASH_SIZE} \
	--sector-size ${DREAMBOX_SECTOR_SIZE}"

# Add "MACHINEBUILD" override for recipes
MACHINEOVERRIDES =. "${@['', '${MACHINEBUILD}:']['${MACHINEBUILD}' != '']}"
```

## meta-brands/meta-dream/conf/machine/include/dreamone.inc
```bitbake
SUMMARY ?= "A Dreambox firmware image for headless systems"

# packages to drag into the image
IMAGE_INSTALL = " \
    packagegroup-boot-systemd \
    packagegroup-net-connman \
    packagegroup-pkg-deb \
    packagegroup-opendreambox-base \
    packagegroup-opendreambox-dvbapi3 \
"

# enable online package management
IMAGE_FEATURES = "package-management"

# we don't want any locales, at least not in the common way.
IMAGE_LINGUAS = ""

# 512MB rootfs
IMAGE_ROOTFS_SIZE_ext4 = "524288"
```
